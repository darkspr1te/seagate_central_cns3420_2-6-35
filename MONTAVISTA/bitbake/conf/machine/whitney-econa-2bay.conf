## MONTAVISTA/bitbake/conf/machine/whitney-econa-2bay.conf
```bitbake
# Seagate ECONA CNS3420 based "Whitney NAS platform machine configuration

TARGET_ARCH = "arm"
PACKAGE_EXTRA_ARCHS = "armv6"

KERNEL_IMAGETYPE = "uImage"

IMAGE_FSTYPES ?= "ext2.gz"

MACHINE_FEATURES = "kernel26 arm usbhost ext2 vfat"
MACHINE_EXTRA_RRECOMMENDS = " kernel-modules"

TARGET_CC_ARCH = "-march=armv6k"
BASE_PACKAGE_ARCH = "armv6"
FEED_ARCH = "armv6"

require conf/toolchain/armv6-glibc-linux.conf

FULL_OPTIMIZATION = "-fexpensive-optimizations -fomit-frame-pointer -frename-registers -Os"
DEBUG_OPTIMIZATION = ""

UBOOT_ENTRYPOINT = "0x2000000"
UBOOT_LOADADDRESS = "0x2000000"

INITRAMFS_IMAGE="initramfs-whitney-image"
```

## arch/arm/mach-cns3xxx/Kconfig
```kconfig
menu "CNS3XXX platform type"
	depends on ARCH_CNS3XXX

config SILICON
	bool "CNS3XXX silicon"


config MACH_CNS3420VB
	bool "Support for CNS3420 Validation Board"
        select ARCH_REQUIRE_GPIOLIB
        select ARM_GIC
        select SILICON

	help
	  Include support for the Cavium Networks CNS3420 MPCore Platform
	  Baseboard.
	  This is a platform with an on-board ARM11 MPCore and has support
	  for USB, USB-OTG, MMC/SD/SDIO, SATA, PCI-E, etc.

choice
        bool "CNS3XXX PCI-E Clock Source"
        depends on MACH_CNS3420VB
        default CNS3XXX_EXTERNAL_CLOCK_SOURCE

#config CNS3XXX_AUTO_CLOCK_SOURCE
#       tristate "Auto Select Clock Source"
#       help
#         Say Y if you don't know how to choose PCI-E clock source

config CNS3XXX_INTERNAL_CLOCK_SOURCE
        tristate "Internal Clock Source"
        help
          Say Y if you use the internal clock source

config CNS3XXX_EXTERNAL_CLOCK_SOURCE
        tristate "External Clock Source"
        help
          Say Y if you use the external clock source

endchoice

config CNS3XXX_PCIE_INTERFACE_0
	bool "CNS3XXX PCI-E Interface 0"
	default y
	depends on MACH_CNS3420VB
	help
	  Say N if you don't use the PCI-E interface 0

config CNS3XXX_PCIE_INTERFACE_1
        bool "CNS3XXX PCI-E Interface 1"
        depends on MACH_CNS3420VB
        default y
        help
          Say N if you don't use the PCI-E interface 1

config CNS3XXX_PCIE_RESET_DEVICE
		bool "Reset PCIe Device by GPIO"
		default y
		depends on ARCH_CNS3XXX
		help
	  	Reset PCIe Device by GPIO before the pcie scan bus.
	  		If unsure, say Y.

config CNS3XXX_RESET_GPIO_BLOCK
		bool "Reset GPIO block at booting"
		default y
		depends on ARCH_CNS3XXX
		help
	  	Reset GPIO block at booting, GPIO pins' value and function will set to default.
	  		If unsure, say Y.

config CNS3XXX_INVERT_SD_WP_PIN_STATE
		bool "Invert SD Write Protect pin state"
		default y
		depends on ARCH_CNS3XXX
		help
	  	Invert SD Write Protect pin state.
	  		If unsure, say Y.

config CNS3XXX_RAID
		bool "Support for CNS3XXX RAID"
		depends on ARCH_CNS3XXX
		help
	  	Enable RAID 4/5/6 Hardware accelartion in CNS3XXX.
	  		If unsure, say N.

config CNS3XXX_DMAC
        bool "Support for CNS3XXX DMAC"
        depends on ARCH_CNS3XXX
        help
          Enable support for the CNS3XXX DMA controllers.

config CNS3XXX_DMAC_M2MTEST
        tristate "Memory-to-Memory Test Module"
        depends on ARCH_CNS3XXX
        depends on CNS3XXX_DMAC
        help
          Say yes here to enable support Memory-to-Memory test module.

config CNS3XXX_GPU_ENVIRONMENT
        bool "CNS3XXX GPU(GC300 2D Acceleration) Support"
        default n
        help
                Say Y if you want to support 2D acceleration.

config CNS3XXX_PCM_LEGERITY_2PHONE_DEMO
        tristate "2 phone PCM sound demo driver"
        depends on SPI
        select SPI_CNS3XXX
#       select LE88221_CONTROL
        default n

choice
        prompt "PCM device"
        depends on CNS3XXX_PCM_LEGERITY_2PHONE_DEMO
        default SI3226

config LE88221_CONTROL
        bool "Le88221"

config SI3226_CONTROL_API
        bool "Si3226 using Proslic API"
        #depends on CNS3XXX_GPIO         # H/W reset seems is not necessary
endchoice

config CNS3XXX_SPEEDUP_NAS
	bool "NAS Speedup"

config CNS3XXX_HIGH_PHYS_OFFSET
    bool "High physical base address for the CNS3XXX platform"
    depends on MMU
    default y
    help
      CNS3XXX boards have the RAM available at 0x20000000,
      256MB of which being mirrored at 0x00000000.
      If the board supports 512MB of RAM, this option allows the
      memory to be accessed contiguously at the high physical
      offset.

config CNS3XXX_EXT_INTR_DEMO
	tristate "External interrupt demo program"
	depends on MACH_CNS3420VB
	select GPIO_CNS3XXX
	help
	  This program hooks interrupt service routine to external interrupts
	  0 ~ 3.
	    Name      EVB             Trigger type  ISR
	    Ext_Int0                  Rising edge
	    Ext_Int1  Push button S3  Rising edge   Toggle LED D6
	    Ext_Int2  Push button S4  High level    Toggle LED D7

endmenu
```

## drivers/net/cns3xxx-nas/cns3xxx-nas/Kconfig
```kconfig
menu "CNS3XXX Gigabit Switch Support"
	depends on ARCH_CNS3XXX

config CNS3XXX_GSW
	tristate "CNS3XXX Gigabit Switch Driver Support"
	depends on ARCH_CNS3XXX
	select CNS3XXX_PSE_INIT
	help
	  CNS3XXX layer-2 Packet Switching Enging(PSE) is a 5-port Layer-2
	  non-blocking shared-memory switch fabric: 3 MAC ports are exposed
	  for external connections, and the other two are used internally for
	  CPU port, and L2/L3/L4 Packet Processing Engine(PPE) respectively.

config CNS3XXX_SPPE
	bool "CNS3XXX Smart PPE(Packet Processing Engine) Support"
	depends on CNS3XXX_GSW
	help
	  PPE(Packet Processing Engine) is a hardware accelerator hook on a port of 
	  CNS3XXX Gigabit Switch.
	  
	  This option is used for Smart PPE hook. 

	  Say Y if you want to enable Smart PPE function.

config CNS3XXX_PSE_WOL
	bool "CNS3XXX PSE Wake-On-LAN Support"
	depends on CNS3XXX_GSW && SUSPEND
	help
	  CNS3XXX PSE block supports Wake-On-LAN(WOL) and requires a specific
	  magic packet to wake up CPU from DOZE mode.

	  Say Y if you want to enable PSE WOL feature.

config CNS3XXX_ETHADDR_IN_FLASH
	bool "CNS3XXX MAC address in flash"
	depends on CNS3XXX_GSW && MTD
	help
	  Say Y if you want to load MAC address from flash.

choice
	prompt "Load MAC address from ..."
	depends on CNS3XXX_ETHADDR_IN_FLASH
	default MAC_IN_PARALLEL_FLASH

config CNS3XXX_MAC_IN_PARALLEL_FLASH
	bool "Parallel Flash"

config CNS3XXX_MAC_IN_SPI_FLASH
	bool "SPI Flash"

endchoice

config CNS3XXX_HCIE_TEST
	bool "CNS3XXX HCIE(Hardware Content Inspection Engine) Support"
#	depends on CNS3XXX_GSW
	help
	  HCIE is patent-protected layer-7 packet processing engine.
	  
	  This option is used for fundamental HCIE functional test . 
	  Say Y if you want to do HCIE functional test.
		

#config CNS3XXX_SHNAT_PCI_FASTPATH
#	bool "FastPath(From PCI to WAN) Support"
#	depends on CNS3XXX_SHNAT
#	help
#	  Add FastPath Support for Smart HNAT.

config BCM53115
	tristate
	depends on VB || VB_2
	select GPIO_CNS3XXX
	select SPI_CNS3XXX
	default m if CNS3XXX_GSW=m
	default y if CNS3XXX_GSW=y

endmenu
```

## drivers/net/cns3xxx_pse_init/Kconfig
```kconfig
menu "CNS3XXX Gigabit Switch Support Init"
	depends on ARCH_CNS3XXX

config CNS3XXX_PSE_INIT
	tristate "CNS3XXX PSE Initialize part"
	depends on ARCH_CNS3XXX && CNS3XXX_GSW
	default m
	help
	  CNS3XXX layer-2 Packet Switching Enging(PSE) is a 5-port Layer-2
	  non-blocking shared-memory switch fabric: 3 MAC ports are exposed
	  for external connections, and the other two are used internally for
	  CPU port, and L2/L3/L4 Packet Processing Engine(PPE) respectively.

config CNS3XXX_PSE_SW_PHY_AUTO_POLLING
	bool "CNS3XXX PSE Software PHY auto-polling"
	depends on ARCH_CNS3XXX && CNS3XXX_GSW
	default n
	help
		Software PHY Auto-Polling enables instead of Hardware PHY Auto-Polling.

choice
	prompt "Board Configuration"
	depends on CNS3XXX_PSE_INIT
	default VB

config FPGA
	bool "VSC8601x2 + IP101A (EXPERIMENTAL)"
	help
	  MAC0, MAC1 connect to two Vitesse VSC8601 gigabit ethernet transceiver.
	  MAC2 connect to IC Plus IP101A 10/100Mbps fast ethernet transceiver.

config AR8021
	bool "Cavium 2Bay NAS demo board(AR8021,EXPERIMENTAL)"
	help
	  MAC0 connect to Atheros AR8021 gigabit ethernet transceiver.
	  MAC1 and MAC2 are left for no connection.

config AR8316
	bool "AR8316 (EXPERIMENTAL)"
	help
	  MAC0 and MAC1 connect to Atheros AR8316 six port gigabit ethernet switch.
	  MAC2 is left for no connection.

config AR8327
	bool "AR8327"
	help
	  MAC0 and MAC1 connect to Atheros AR8327 7 port gigabit ethernet switch.
	  MAC2 is left for no connection.
	  CNS34XX RG Demo Board v1.0

config IP1001_X2
        bool "IP1001x2 (EXPERIMENTAL)"
	help
	  MAC0, MAC1 connect to two IC Plus IP1001 gigabit ethernet transceiver.
	  MAC2 is left for no connection.

config RTL8367
	bool "RTL8367 (EXPERIMENTAL)"
	help
	  MAC0 and MAC1 connect to Realtek RTL8367 5-port 10/100/1000 switch controller.
	  MAC2 is left for no connection.

config RTL8367_ONE_LEG
	bool "RTL8367 ONE LEG (EXPERIMENTAL)"
	help
	  MAC0 connect to Realtek RTL8367 5-port 10/100/1000 switch controller.
	  MAC1/MAC2 is left for no connection.

config RTL8366RB
	bool "RTL8366RB (EXPERIMENTAL)"
	help
	  MAC0 and MAC1 connect to Realtek RTL8366RB 10/100/1000 switch controller.
	  MAC2 is left for no connection.

config RTL8211
	bool "RTL8211 (EXPERIMENTAL)"
	help
	  MAC0 connects to Realtek RTL8211 gigabit ethernet transceiver.
	  MAC1 and MAC2 are left for no connection.

config RTL8211_X2
    bool "RTL8211_X2 (EXPERIMENTAL)"
	help
	  MAC0, MAC1 connect to two Realtek RTL8211 gigabit ethernet transceiver.
	  MAC2 is left for no connection.

config RTL8211_MAC0_PHYADDR1
	bool "RTL8211_MAC0_PHYADDR1 (EXPERIMENTAL)"
	help
	  MAC0 connects to Realtek RTL8211 gigabit ethernet transceiver.
	  MAC1 and MAC2 are left for no connection.

config VB
	bool "Validation Board 1.x or 2.X"
	help
	  This configuration is used for CNS3420 Validation Board version: 1.1, 1,2 and 1.3.
	  MAC0 and MAC1 connect to Broadcom BCM53115M 5-port 10/100/1000 switch.
	  MAC2 connect to IC Plus IP1001 gigabit ethernet transceiver (1.X).
	  MAC2 connect to Realtek RTL8211 gigabit ethernet transceiver (2.X).

config VITESSE7395
	bool "VITESSE_7395 (EXPERIMENTAL)"
        help
	  This configureation connect MAC0 to Vitesse 7395
          And run at 802.1p mode. WAN port vid is 2, LAN port vid is 3

endchoice

config BCM53115
	tristate
	depends on VB
	select GPIO_CNS3XXX
	select SPI_CNS3XXX
	default m if CNS3XXX_GSW=m
	default y if CNS3XXX_GSW=y

config VTE7395
	tristate
	depends on VITESSE7395
	select GPIO_CNS3XXX
	select SPI_CNS3XXX
	default m if CNS3XXX_GSW=m
	default y if CNS3XXX_GSW=y

endmenu
```

## fs/proc/static/Kconfig
```kconfig
config PROC_STATIC_FILES
	tristate "Support for statically initialized /proc files"
	default y
	depends on PROC_FS
	help
	  This enables all of the files in the kernel source directory
	  fs/proc/static/files at kernel build time to be available in
	  /proc.   It is useful for recording kernel configuration information.
```

## sound/soc/cns3xxx/Kconfig
```kconfig
config SND_CNS3XXX_SOC
	tristate

config SND_CNS3XXX_SOC_I2S
	tristate

config SND_CNS3XXX_SOC_CHIP
	tristate "I2S interface audio card driver"
	depends on ARCH_CNS3XXX
	select PL330_DMAC
	select SND_CNS3XXX_SOC
	select SND_CNS3XXX_SOC_I2S
	select I2C_CNS3XXX
	help
	  Say Y if you want to add support for I2S SoC audio on
	  CNS3XXX chip

choice
	bool "Codec Type"
	depends on SND_CNS3XXX_SOC_CHIP
	default CNS3XXX_CODEC_WM8991

config CNS3XXX_CODEC_WM8991
	tristate "Wolfson WM8991 Mobile Multimedia CODEC"
	select SND_SOC_WM8991 if SND_CNS3XXX_SOC_CHIP=y
	help
	  The WM8991 is a highly integrated ultra-low power hi-fi CODEC
	  designed for handsets rich in multimedia features such as GPS,
	  mobile TV, digital audio playback and gaming. Ultra-low power
	  and low noise interfaces to many other audio components in the
	  system are provided.

config CNS3XXX_CODEC_WM8580
	tristate "Wolfson WM8580 CODEC with S/PDIF transceiver"
	select SND_SOC_WM8580 if SND_CNS3XXX_SOC_CHIP=y
	help
	  The WM8580 is a multi-channel audio CODEC with S/PDIF transceiver.
	  The WM8580 is ideal for DVD and surround sound processing
	  applications for home hi-fi, automotive and other audiovisual
	  equipment.

config CNS3XXX_CODEC_WAU8822
	tristate "Nuvoton WAU8822 Audio CODEC"
	select SND_SOC_WAU8822 if SND_CNS3XXX_SOC_CHIP=y
	help
	  Nuvoton WAU8822 is a Stereo, 24-Bit ADC and DAC, Built In Amps:
	  1W Speaker and 40mW Head Phone audio CODEC.

endchoice

config SND_CNS3XXX_SOC_PCM1
	tristate "Wolfson WM9081 mono DAC support(PCM1)"
	depends on ARCH_CNS3XXX
	select PL330_DMAC
	select SND_SOC_WM9081
	select SND_CNS3XXX_SOC_PCM1_FMT
	select SND_CNS3XXX_SOC_PCM1_TRNSFR
	help
          WM9081: Mono DAC with Integrated 2.6W Class AB/D Amplifier
	  The WM9081 is designed to provide high power output at low distortion
	  levels in space-constrained portable applications.
	  For general information, goto Wolfcon support website at:
	  <http://www.wolfsonmicro.com/products/audio_amplifiers/WM9081/>

config SND_CNS3XXX_SOC_PCM1_FMT
	tristate

config SND_CNS3XXX_SOC_PCM1_TRNSFR
	tristate
```
